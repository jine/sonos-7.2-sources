## linux-2.6.21/drivers/mmc/Kconfig
```kconfig
#
# MMC subsystem configuration
#

menu "MMC/SD Card support"

config MMC
	tristate "MMC support"
	help
	  MMC is the "multi-media card" bus protocol.

	  If you want MMC support, you should say Y here and also
	  to the specific driver for your MMC interface.

config MMC_DEBUG
	bool "MMC debugging"
	depends on MMC != n
	help
	  This is an option for use by developers; most people should
	  say N here.  This enables MMC core and driver debugging.

config MMC_OPEN_SOURCE
	tristate "MMC Open Source support"
	depends on MMC
	default n
	help
	  Say Y here to enable the MMC Open Source support.

config MMC_BLOCK
	tristate "MMC block device driver"
	depends on MMC && BLOCK
	default y
	help
	  Say Y here to enable the MMC block device driver support.
	  This provides a block device driver, which you can use to
	  mount the filesystem. Almost everyone wishing MMC support
	  should say Y or M here.

config MMC_PROTOCOL
	tristate "MMC protocol"
	depends on MMC && !MMC_OPEN_SOURCE
	default y
	help
	  Say Y here to enable the MMC protocol driver support.
	  This provides a protocol driver, which you can use to 
	  support MMC card. Almost everyone wishing MMC support
	  should say Y or M here.

config SD_PROTOCOL
	tristate "SD protocol"
	depends on MMC && !MMC_OPEN_SOURCE
	default y
	help
	  Say Y here to enable the SD protocol driver support.
	  This provides a protocol driver, which you can use to 
	  support MMC card. Almost everyone wishing SD support
	  should say Y or M here.

config SDIO_PROTOCOL
	tristate "SDIO protocol"
	depends on MMC && !MMC_OPEN_SOURCE
	default y
	help
	  Say Y here to enable the SDIO protocol driver support.
	  This provides a protocol driver, which you can use to 
	  support SDIO card. Almost everyone wishing SDIO support
	  should say Y or M here.


config MMC_ARMMMCI
	tristate "ARM AMBA Multimedia Card Interface support"
	depends on ARM_AMBA && MMC
	help
	  This selects the ARM(R) AMBA(R) PrimeCell Multimedia Card
	  Interface (PL180 and PL181) support.  If you have an ARM(R)
	  platform with a Multimedia Card slot, say Y or M here.

	  If unsure, say N.

config MMC_PXA
	tristate "Zylonite Multimedia Card Interface support"
	depends on ARCH_PXA && MMC
	default y
	help
	  This selects the PXA3xx Platform Development Kit (Zylonite)
          Multimedia card Interface.If you have a Zylonite platform with
	  a Multimedia Card slot,say Y or M here.

	  If unsure, say N.

config MMC1_SLOT1
	bool "Support MMC1 slot 1"
	default n
	depends on MMC_PXA && !PCCARD && !MMC_OPEN_SOURCE
	help
	  This selects the PXA3xx Platform Development Kit (Zylonite)
          Multimedia Controller 1 Slot 1(controller 1 has 2 slots: Slot0 
	  and Slot1). If you want to use slot 2, say Y here.

config MMC2
	bool "Support MMC2 controller"
	default n
	depends on MMC_PXA
	help
	  This selects the PXA3xx Platform Development Kit (Zylonite)
          Multimedia Controller 2.If you want to use controller 2,
	  say Y here.

config MMC3
	bool "Support MMC3 controller"
	default n
	depends on MMC_PXA && CPU_PXA310
	help
	  This selects the PXA310 Platform Development Kit (Zylonite)
          Multimedia Controller 3.If you want to use controller 3,
	  say Y here.

config MMC_CEATA
	bool "Support CEATA"
	default n
	depends on MMC_PXA && !MMC_OPEN_SOURCE 
	help
	  This selects the CEATA protocol support

config MMC_SDHCI
	tristate "Secure Digital Host Controller Interface support  (EXPERIMENTAL)"
	depends on PCI && MMC && EXPERIMENTAL
	help
	  This select the generic Secure Digital Host Controller Interface.
	  It is used by manufacturers such as Texas Instruments(R), Ricoh(R)
	  and Toshiba(R). Most controllers found in laptops are of this type.
	  If you have a controller with this interface, say Y or M here.

	  If unsure, say N.

config MMC_OMAP
	tristate "TI OMAP Multimedia Card Interface support"
	depends on ARCH_OMAP && MMC
	select TPS65010 if MACH_OMAP_H2
	help
	  This selects the TI OMAP Multimedia card Interface.
	  If you have an OMAP board with a Multimedia Card slot,
	  say Y or M here.

	  If unsure, say N.

config MMC_WBSD
	tristate "Winbond W83L51xD SD/MMC Card Interface support"
	depends on MMC && ISA_DMA_API
	help
	  This selects the Winbond(R) W83L51xD Secure digital and
          Multimedia card Interface.
	  If you have a machine with a integrated W83L518D or W83L519D
	  SD/MMC card reader, say Y or M here.

	  If unsure, say N.

config MMC_AU1X
	tristate "Alchemy AU1XX0 MMC Card Interface support"
	depends on MMC && SOC_AU1200
	help
	  This selects the AMD Alchemy(R) Multimedia card interface.
	  If you have a Alchemy platform with a MMC slot, say Y or M here.

	  If unsure, say N.

config MMC_AT91
	tristate "AT91 SD/MMC Card Interface support"
	depends on ARCH_AT91 && MMC
	help
	  This selects the AT91 MCI controller.

	  If unsure, say N.

config MMC_IMX
	tristate "Motorola i.MX Multimedia Card Interface support"
	depends on ARCH_IMX && MMC
	help
	  This selects the Motorola i.MX Multimedia card Interface.
	  If you have a i.MX platform with a Multimedia Card slot,
	  say Y or M here.

	  If unsure, say N.

config MMC_TIFM_SD
	tristate "TI Flash Media MMC/SD Interface support  (EXPERIMENTAL)"
	depends on MMC && EXPERIMENTAL && PCI
	select TIFM_CORE
	help
	  Say Y here if you want to be able to access MMC/SD cards with
	  the Texas Instruments(R) Flash Media card reader, found in many
	  laptops.
	  This option 'selects' (turns on, enables) 'TIFM_CORE', but you
	  probably also need appropriate card reader host adapter, such as
	  'Misc devices: TI Flash Media PCI74xx/PCI76xx host adapter support
	  (TIFM_7XX1)'.

          To compile this driver as a module, choose M here: the
	  module will be called tifm_sd.

endmenu
```

## linux-2.6.21/sound/arm/Kconfig
```kconfig
# ALSA ARM drivers

menu "ALSA ARM devices"
	depends on SND!=n && ARM

config SND_SA11XX_UDA1341
	tristate "SA11xx UDA1341TS driver (iPaq H3600)"
	depends on ARCH_SA1100 && SND && L3
	select SND_PCM
	help
	  Say Y here if you have a Compaq iPaq H3x00 handheld computer
	  and want to use its Philips UDA 1341 audio chip.

	  To compile this driver as a module, choose M here: the module
	  will be called snd-sa11xx-uda1341.

config SND_ARMAACI
	tristate "ARM PrimeCell PL041 AC Link support"
	depends on SND && ARM_AMBA
	select SND_PCM
	select SND_AC97_CODEC

config SND_PXA2XX_PCM
	tristate
	select SND_PCM

config SND_PXA2XX_AC97
	tristate "AC97 driver for the Intel PXA2xx chip"
	depends on ARCH_PXA && SND
	select SND_PXA2XX_PCM
	select SND_AC97_CODEC
	help
	  Say Y or M if you want to support any AC97 codec attached to
	  the PXA2xx AC97 interface.

config SND_CODEC
	bool

config SND_ZYLONITE_CORE
	bool
	select SND_CODEC

config SND_ZYLONITE
	bool "PXA3xx Processor audio driver"
	depends on SND && MACH_ZYLONITE
	select SND_PCM
	select SND_ZYLONITE_CORE
	help
	  Say Y to enable the audio driver on PXA3xx Processor Platform Development Kit (Zylonite)

config BASE_BAND_AUDIO
	boolean "ZYlonite Base Band Audio Support"
	depends on SND_ZYLONITE

config AC97_EXTCLK
	boolean "PXA3xx Processor AC97 External Clock"
	depends on SND_ZYLONITE || SND_ZYLONITE_TOUCH
	help
	  Say Y to use AC97 external clock. AC97 can work under
	  D0CS when the option is enabled

config SND_LITTLETON_CORE
	boolean "Littleton sound support"
	depends on SND && ( MACH_LITTLETON || MACH_WOODSTOCK )
	select SND_PCM
	select SND_CODEC
	help
	  Say Y to enable the Littleton sound support

source "sound/arm/codec/Kconfig"


endmenu
```

## linux-2.6.21/sound/arm/codec/Kconfig
```kconfig
menu "Codec Select"

config CODEC_AC97_ZY
	bool "AC97 Codec for Zylonite Platform"
	depends on SND_ZYLONITE_CORE
	help
	  Say Y to enable the AC97 Codec for Zylonite support.

config CODEC_MICCO_LT
	bool "Micco Codec for Littleton Platform"
	depends on SND_LITTLETON_CORE && PXA3xx_MICCO
	help
	  Say Y to enable the Micco Codec for Littleton support.

endmenu
```
